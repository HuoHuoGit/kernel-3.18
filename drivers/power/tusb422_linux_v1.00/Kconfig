## drivers/power/tusb422_linux_v1.00/Kconfig
```kconfig
config TUSB422
	bool "Enable TUSB422 USB Power Delivery"
	default y

config TUSB422_PAL
	bool "Enable TUSB422 Platform Abstraction Layer"
	default n
	depends on TUSB422
```
